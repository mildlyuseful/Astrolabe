## firmware/zmk/config/west.yml
```yaml
# SPDX-FileCopyrightText: 2026 Dylan Lee
# SPDX-License-Identifier: Apache-2.0

manifest:
  remotes:
    - name: zmkfirmware
      url-base: https://github.com/zmkfirmware

  projects:
    # ZMK v0.3.0. Pin the release commit rather than the movable tag.
    - name: zmk
      remote: zmkfirmware
      revision: edf5c0814fd3ea202e43aad2d68fd32e882a518c
      import:
        file: app/west.yml
        name-allowlist:
          - zephyr
          - nanopb
          - zmk-studio-messages

    # Override the tag imported by ZMK with the exact commit resolved for v0.3.0.
    - name: zephyr
      remote: zmkfirmware
      revision: dacab4875df72109b96cc8977547a0dc04875bcd
      path: zephyr
      import:
        name-blocklist:
          - ci-tools
          - hal_altera
          - hal_cypress
          - hal_infineon
          - hal_microchip
          - hal_nxp
          - hal_openisa
          - hal_silabs
          - hal_st
          - hal_ti
          - hal_xtensa
          - loramac-node
          - mcuboot
          - mcumgr
          - net-tools
          - openthread
          - edtt
          - trusted-firmware-m

  self:
    path: config
```

## firmware/zmk/module/Kconfig
```kconfig
# SPDX-FileCopyrightText: 2026 Dylan Lee
# SPDX-License-Identifier: Apache-2.0

menuconfig ASTROLABE_FIRMWARE
    bool "Astrolabe dual-sensor trackball firmware"
    default y if SHIELD_ASTROLABE
    select GPIO
    select ZMK_POINTING

if ASTROLABE_FIRMWARE

config ASTROLABE_GATT
    bool "Frozen Astrolabe BLE rotation and input service"
    default y
    depends on BT

config ASTROLABE_USB
    bool "Astrolabe USB vendor HID transport"
    default y
    depends on ZMK_USB

config ASTROLABE_DAEMON_LAYER
    int "Keymap layer activated while a daemon owns the route"
    default 1
    help
      Layer index activated when a daemon claims the route and deactivated when it releases.
      It exists so standalone-only gestures -- recovery holds, HID mouse buttons -- cannot fire
      while the daemon owns input, and so daemon control bits are reported with no arbitration
      delay in front of them.

      The route is the sole writer of this layer. Do not bind a layer behavior to it: the route
      can change with no user action at all (cable pull, daemon crash, keepalive timeout), and
      two writers would desynchronise with no way to recover. Must match the second layer
      declared in the keymap.

config ASTROLABE_INDICATOR
    bool "Status LED for BLE profile, bond state, and selected endpoint"
    default y
    depends on ZMK_BLE
    help
      Drives the board's red user LED, aliased as astrolabe-status-led in the shield. Three of the
      four standalone gestures change radio or endpoint state on a device with no screen, so
      without this they cannot be distinguished from doing nothing at all.

      Event-driven: dark at rest, blinking only on a change. A repeating state display would cost
      battery during the time nobody is watching it.

config ASTROLABE_LOG_LEVEL
    int "Astrolabe log level"
    range 0 4
    default 2

endif
```

## firmware/zmk/module/boards/shields/astrolabe/Kconfig.defconfig
```kconfig
# SPDX-FileCopyrightText: 2026 Dylan Lee
# SPDX-License-Identifier: Apache-2.0

if SHIELD_ASTROLABE

config ZMK_KEYBOARD_NAME
    default "Astrolabe"

config ZMK_POINTING
    default y

config ZMK_BATTERY_REPORTING
    default y

endif
```

## firmware/zmk/module/boards/shields/astrolabe/Kconfig.shield
```kconfig
# SPDX-FileCopyrightText: 2026 Dylan Lee
# SPDX-License-Identifier: Apache-2.0

config SHIELD_ASTROLABE
    def_bool $(shields_list_contains,astrolabe)
```

## firmware/zmk/module/dts/bindings/behaviors/astrolabe,behavior-control-bit.yaml
```yaml
# SPDX-FileCopyrightText: 2026 Dylan Lee
# SPDX-License-Identifier: Apache-2.0

description: |
  Single-parameter Astrolabe control behavior, taking only the protocol bit index and
  reporting no standalone HID mouse button.

  This exists because ZMK's hold-tap passes exactly one parameter to each of its bindings, so
  the two-parameter astrolabe,behavior-control cannot be nested inside one. It is only useful
  for positions whose standalone mouse-button mask is zero.

compatible: "astrolabe,behavior-control-bit"

include: one_param.yaml
```

## firmware/zmk/module/dts/bindings/behaviors/astrolabe,behavior-control.yaml
```yaml
# SPDX-FileCopyrightText: 2026 Dylan Lee
# SPDX-License-Identifier: Apache-2.0

description: Route-aware Astrolabe five-way control behavior
compatible: "astrolabe,behavior-control"

include: two_param.yaml
```

## firmware/zmk/module/dts/bindings/behaviors/astrolabe,behavior-output-toggle.yaml
```yaml
# SPDX-FileCopyrightText: 2026 Dylan Lee
# SPDX-License-Identifier: Apache-2.0

description: |
  Toggles the preferred output transport and reports the result on the status LED, including the
  case where ZMK cannot apply the change because only one transport is ready.

compatible: "astrolabe,behavior-output-toggle"

include: zero_param.yaml
```

## firmware/zmk/module/dts/bindings/input/astrolabe,dual-pmw3610.yaml
```yaml
# SPDX-FileCopyrightText: 2026 Dylan Lee
# SPDX-License-Identifier: Apache-2.0

description: Astrolabe dual PMW3610 composite pointing device
compatible: "astrolabe,dual-pmw3610"

include: base.yaml

properties:
  sclk-gpios:
    type: phandle-array
    required: true
  sdio-gpios:
    type: phandle-array
    required: true
  cs-gpios:
    type: phandle-array
    required: true
  motion-gpios:
    type: phandle-array
    required: true
  cpi:
    type: int
    required: true
  ball-diameter-um:
    type: int
    required: true
  sensor-phi-mdeg:
    type: array
    required: true
  sensor-theta-mdeg:
    type: array
    required: true
  sensor-mount-mdeg:
    type: array
    required: true
  sensor-flipped:
    type: array
    required: true
  frame-tilt-mdeg:
    type: int
    required: true
  poll-interval-us:
    type: int
    default: 1000
  active-window-ms:
    type: int
    default: 2000
  send-interval-ms:
    type: int
    default: 7
  cursor-gain-milli:
    type: int
    required: true
  scroll-gain-milli:
    type: int
    required: true
  scroll-divisor:
    type: int
    required: true
  yaw-deadzone-milli:
    type: int
    required: true
  yaw-dominance-milli:
    type: int
    required: true
  scroll-hold-ms:
    type: int
    required: true
```

## firmware/zmk/module/dts/bindings/misc/astrolabe,route.yaml
```yaml
# SPDX-FileCopyrightText: 2026 Dylan Lee
# SPDX-License-Identifier: Apache-2.0

description: Astrolabe output ownership and forced-standalone control
compatible: "astrolabe,route"

include: base.yaml

properties:
  force-standalone-gpios:
    type: phandle-array
    required: true
```
