## firmware/module/Kconfig
```kconfig
# SPDX-FileCopyrightText: 2026 Dylan Lee
# SPDX-License-Identifier: Apache-2.0

menuconfig ASTROLABE
    bool "Astrolabe 3D controller"
    default y if SHIELD_ASTROLABE
    select GPIO
    select ZMK_POINTING
    help
      The controller core: routes motion and controls to a host HID mouse, or to a daemon that
      claims the route over BLE or USB.

if ASTROLABE

config ASTROLABE_BLE
    bool "BLE daemon transport"
    default y
    depends on ZMK_BLE

config ASTROLABE_USB
    bool "USB vendor-HID daemon transport"
    default y
    depends on ZMK_USB

config ASTROLABE_DAEMON_LAYER
    int "Keymap layer active while a daemon owns the route"
    default 1
    help
      The route is the only writer of this layer; never bind a layer behavior to it. The route
      changes with no user action (cable pull, daemon exit, keepalive timeout), and a second
      writer would leave the two out of step.

config ASTROLABE_INDICATOR
    bool "Status LED for endpoint and BLE profile changes"
    default y
    depends on ZMK_BLE
    help
      Drives the LED aliased astrolabe-status-led. Event-driven: dark at rest.

config ASTROLABE_DUAL_PMW3610
    bool "Dual PMW3610 trackball motion source"
    default y
    depends on DT_HAS_ASTROLABE_DUAL_PMW3610_ENABLED

config ASTROLABE_CALIBRATION_LOG
    bool "Log raw sensor deltas for tools/calibrate_sensor_mounts.py"
    depends on ASTROLABE_DUAL_PMW3610 && LOG

config ASTROLABE_LOG_LEVEL
    int "Astrolabe log level"
    range 0 4
    default 2

endif
```

## firmware/module/dts/bindings/astrolabe,controller.yaml
```yaml
# SPDX-FileCopyrightText: 2026 Dylan Lee
# SPDX-License-Identifier: Apache-2.0

description: |
  The Astrolabe controller core: delivery pacing, the standalone HID mouse it falls back to, and
  the forced-standalone escape. Rotation values are in radians; gains are per radian.

compatible: "astrolabe,controller"

include: base.yaml

properties:
  force-standalone-gpios:
    type: phandle-array
    description: Held through boot, daemon claims are refused until reboot.
  control-buttons:
    type: array
    description: Standalone HID button mask (MB1..MB5) per control bit; 0 for no click.
  send-interval-ms:
    type: int
    default: 7
    description: Delivery window; motion is accumulated and sent at most this often.
  cursor-gain-milli:
    type: int
    required: true
  scroll-gain-milli:
    type: int
    required: true
  scroll-divisor:
    type: int
    required: true
    description: Scroll accumulator units per wheel detent.
  yaw-deadzone-milli:
    type: int
    required: true
  yaw-dominance-milli:
    type: int
    required: true
  scroll-hold-ms:
    type: int
    required: true
```

## firmware/module/dts/bindings/astrolabe,dual-pmw3610.yaml
```yaml
# SPDX-FileCopyrightText: 2026 Dylan Lee
# SPDX-License-Identifier: Apache-2.0

description: |
  Two PMW3610 sensors on a shared three-wire bus viewing one ball. Poses are spherical angles of
  each sensor's normal in millidegrees; see docs/hardware.md.

compatible: "astrolabe,dual-pmw3610"

include: base.yaml

properties:
  sclk-gpios: {type: phandle-array, required: true}
  sdio-gpios: {type: phandle-array, required: true}
  cs-gpios: {type: phandle-array, required: true}
  motion-gpios: {type: phandle-array, required: true}
  cpi: {type: int, required: true}
  ball-diameter-um: {type: int, required: true}
  sensor-phi-mdeg: {type: array, required: true}
  sensor-theta-mdeg: {type: array, required: true}
  sensor-mount-mdeg: {type: array, required: true}
  sensor-flipped: {type: array, required: true}
  frame-tilt-mdeg: {type: int, required: true}
  poll-interval-us: {type: int, default: 1000}
  active-window-ms:
    type: int
    default: 2000
    description: |
      Keep polling this long after the last motion or control press. Long enough to span pauses
      in ordinary use, so the sensors stay in run mode instead of re-waking on every touch.
```

## firmware/module/dts/bindings/behaviors/astrolabe,behavior-control.yaml
```yaml
# SPDX-FileCopyrightText: 2026 Dylan Lee
# SPDX-License-Identifier: Apache-2.0

description: Reports an Astrolabe control bit. Parameter is the protocol bit index.
compatible: "astrolabe,behavior-control"
include: one_param.yaml
```

## firmware/module/dts/bindings/behaviors/astrolabe,behavior-output-toggle.yaml
```yaml
# SPDX-FileCopyrightText: 2026 Dylan Lee
# SPDX-License-Identifier: Apache-2.0

description: Toggles USB/BLE output and reports the outcome on the status LED.
compatible: "astrolabe,behavior-output-toggle"
include: zero_param.yaml
```
